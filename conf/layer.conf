## conf/layer.conf
```bitbake
BBPATH := "${BBPATH}:${LAYERDIR}"

BBFILES := "${BBFILES} ${LAYERDIR}/recipes-*/*/*.bb \
           ${LAYERDIR}/recipes-*/*/*.bbappend \
           ${LAYERDIR}/images/*.bb*"


BBFILE_COLLECTIONS += "freescale-trustx"
BBFILE_PATTERN_freescale-trustx := "^${LAYERDIR}/"
BBFILE_PRIORITY_freescale-trustx := "8"

LAYERSERIES_COMPAT_freescale-trustx = "dunfell"
```
